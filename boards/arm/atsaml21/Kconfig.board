## boards/arm/atsaml21/Kconfig.board
```kconfig
# SAM L21 Board configuration

# Copyright (c) 2018 Bryan O'Donoghue
# SPDX-License-Identifier: Apache-2.0

config BOARD_ATSAML21
	bool "SAM L21"
	depends on SOC_PART_NUMBER_SAML21E18A
```

## boards/arm/exen_mini/Kconfig.board
```kconfig
# Arduino Zero Board configuration

# Copyright (c) 2017 Google LLC.
# SPDX-License-Identifier: Apache-2.0

config BOARD_EXEN_MINI
	bool "Exen Mini"
	depends on SOC_PART_NUMBER_SAMD21G18A
```

## boards/arm/exen_mini/Kconfig.defconfig
```kconfig
# Arduino Zero board configuration

# Copyright (c) 2017 Google LLC.
# SPDX-License-Identifier: Apache-2.0

config BOARD
	default "exen_mini"
	depends on BOARD_EXEN_MINI
```

## boards/arm/frdm_k66f/Kconfig.defconfig
```kconfig
# FRDM-K66F board

# Copyright (c) 2016, Freescale Semiconductor, Inc.
# SPDX-License-Identifier: Apache-2.0

if BOARD_FRDM_K66F

config BOARD
	default "frdm_k66f"

config OSC_XTAL0_FREQ
	default 12000000

config MCG_PRDIV0
	default 0

config MCG_VDIV0
	default 0xe

config MCG_FCRDIV
	default 1

#config SPI_0
#    default y
#    depends on SPI

if NETWORKING

config NET_L2_ETHERNET
	default y if !MODEM

#config ETH_MCUX_0
#	default y if NET_L2_ETHERNET

endif # NETWORKING

endif # BOARD_FRDM_K66F
```

## boards/arm/frdm_k66f/frdm_k66f_defconfig
```kconfig
# SPDX-License-Identifier: Apache-2.0

CONFIG_SOC_MK66F18=y
CONFIG_SOC_SERIES_KINETIS_K6X=y
CONFIG_BOARD_FRDM_K66F=y
CONFIG_CORTEX_M_SYSTICK=y
CONFIG_GPIO=y
CONFIG_SYS_CLOCK_HW_CYCLES_PER_SEC=180000000
CONFIG_OSC_LOW_POWER=y
CONFIG_CONSOLE=y
CONFIG_UART_CONSOLE=y
CONFIG_SERIAL=y
CONFIG_PINCTRL=y

# Enable MPU
CONFIG_ARM_MPU=y

# enable SPI
CONFIG_SPI=y
```
